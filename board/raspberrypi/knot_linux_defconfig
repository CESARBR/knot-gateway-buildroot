## package/knot-netsetup/Config.in
```kconfig
config BR2_PACKAGE_KNOT_NETSETUP
	bool "knot-netsetup"
	depends on BR2_PACKAGE_BLUEZ5_UTILS=y
	depends on BR2_PACKAGE_BLUEZ5_UTILS_CLIENT=y
	depends on BR2_PACKAGE_BLUEZ5_UTILS_DEPRECATED=y
	depends on BR2_PACKAGE_BLUEZ_TOOLS=y
	depends on BR2_PACKAGE_CONNMAN
	depends on BR2_PACKAGE_WPANTUND
	select BR2_PACKAGE_PYTHON_SETUPTOOLS
	select BR2_PACKAGE_PYTHON_LOCKFILE
	select BR2_PACKAGE_PYTHON_GOBJECT
	select BR2_PACKAGE_PYTHON_DAEMON
	select BR2_PACKAGE_PYTHON_DOCUTILS
	select BR2_PACKAGE_DBUS_PYTHON
	help
	  KNoT netsetup is a daemon to setup network interfaces (currently
	  Openthread wpan0 interface) from DBus or Bluetooth interfaces.
```

## package/knot-network-nrf24/Config.in
```kconfig
config BR2_PACKAGE_KNOT_NETWORK_NRF24
	bool "knot-network-nrf24"
	depends on BR2_PACKAGE_KNOT_PROTOCOL_LIB
	depends on BR2_PACKAGE_KNOT_HAL_DRIVER
	select BR2_PACKAGE_LIBELL
	help
	  The PAN Network Manager is responsible for establishing a
	  Personal Area Network (PAN) with devices using this type of
	  protocol stack. In our reference implementation, the nRF24l01+
	  radio was used for the PAN network. The daemon nrfd has the
	  NRF24L01+drivers, PHY, Link, and network layers of this stack.
```

## package/knot-protocol-lib/Config.in
```kconfig
config BR2_PACKAGE_KNOT_PROTOCOL_LIB
	bool "knot-protocol-lib"
	help
	  KNOT Application layer protocol library is a lightweight C
	  library built to use minimal CPU and memory resources. It
	  provides the application layer messages definition for
	  exchanging messages between KNoT Nodes (KNoT Thing Devices),
	  KNoT Gateway and KNoT Apps.
```

## package/knot-service-app/Config.in
```kconfig
config BR2_PACKAGE_KNOT_SERVICE_APP
	bool "knot-service-app"
	depends on BR2_PACKAGE_KNOT_PROTOCOL_LIB
	depends on BR2_PACKAGE_KNOT_HAL_DRIVER
	depends on BR2_PACKAGE_KNOT_FOG
	select BR2_PACKAGE_LIBCURL
	select BR2_PACKAGE_RABBITMQ_C
	select BR2_PACKAGE_LIBELL
	select BR2_PACKAGE_LIBGLIB2
	select BR2_PACKAGE_JSON_C
	help
	  KNOT service is part of KNOT project. Provides knotd daemon
	  and inetbrd daemon.

	  knotd: acting as proxy between the network managers and the
	  KNoTFog, thus providing a central point for handling KNoT
	  devices, protocol translation, and message forwarding
	  capabilities.
	  inetbrd: creates an IP bridge for sending the traffic from
	  local interfaces to the KNoT Device Manager (knotd).
```

## package/knot-storage/Config.in
```kconfig
config BR2_PACKAGE_KNOT_STORAGE
    bool "knot-storage"
    depends on BR2_PACKAGE_HOST_GO_ARCH_SUPPORTS
    depends on BR2_PACKAGE_HOST_GO_CGO_LINKING_SUPPORTS
    depends on BR2_PACKAGE_RABBITMQ_SERVER
    depends on BR2_PACKAGE_MONGODB
    depends on BR2_PACKAGE_KNOT_BABELTOWER
    help
	Stores the sensor data sent by the things registered on KNoT Cloud.
	https://github.com/CESARBR/knot-cloud-storage
```

## package/knot-virtualthing/Config.in
```kconfig
config BR2_PACKAGE_KNOT_VIRTUALTHING
	bool "knot-virtualthing"
	select BR2_PACKAGE_LIBELL
	select BR2_PACKAGE_KNOT_CLOUD_SDK
	select BR2_PACKAGE_KNOT_PROTOCOL_LIB
	select BR2_PACKAGE_LIBMODBUS
	help
	  The KNoT VirtualThing virtualizes a KNoT Device providing an
	  abstraction to allow certain protocols to interact with a cloud.
```

## package/knot-web/Config.in
```kconfig
config BR2_PACKAGE_KNOT_WEB
    bool "knot-web"
    depends on BR2_PACKAGE_MONGODB
    select BR2_PACKAGE_NODEJS
    select BR2_PACKAGE_AVAHI
    help
      The KNoT Gateway UI is a Web interface for managing KNoT devices
	  coming from all networks and also for managing the gateway itself
	  in terms of configuring IP, user credentials, etc.
```

## package/libell/Config.in
```kconfig
config BR2_PACKAGE_LIBELL
        bool "libell"
         depends on BR2_TOOLCHAIN_GCC_AT_LEAST_4_3
	 depends on BR2_TOOLCHAIN_USES_GLIBC
	help
	  The Embedded Linux Library (ELL) provides core,
	  low-level functionality for system daemons.

	  https://01.org/ell
```

## package/lnd/Config.in
```kconfig
config BR2_PACKAGE_LND
	bool "lnd"
	depends on BR2_PACKAGE_HOST_GO_ARCH_SUPPORTS && (BR2_PACKAGE_NEUTRINO || BR2_PACKAGE_BTCD || BR2_PACKAGE_BITCOIN)
	select BR2_PACKAGE_HOST_GO_DEP
	help
	  The Lightning Network Daemon (lnd) - is a complete
	  implementation of a Lightning Network node and currently
	  deployed on testnet3 - the Bitcoin Test Network. lnd has
	  several pluggable back-end chain services including btcd (a
	  full-node), bitcoind, and neutrino (a new experimental light
	  client). The project's codebase uses the btcsuite set of
	  Bitcoin libraries, and also exports a large set of isolated
	  re-usable Lightning Network related libraries within it.

	  https://lightning.network/
```
