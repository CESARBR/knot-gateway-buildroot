## board/raspberrypi/knot_linux_defconfig
```kconfig
CONFIG_IPV6_OPTIMISTIC_DAD=y

CONFIG_6LOWPAN=m
# CONFIG_6LOWPAN_DEBUGFS is not set
CONFIG_6LOWPAN_NHC=m
CONFIG_6LOWPAN_NHC_DEST=m
CONFIG_6LOWPAN_NHC_FRAGMENT=m
CONFIG_6LOWPAN_NHC_HOP=m
CONFIG_6LOWPAN_NHC_IPV6=m
CONFIG_6LOWPAN_NHC_MOBILITY=m
CONFIG_6LOWPAN_NHC_ROUTING=m
CONFIG_6LOWPAN_NHC_UDP=m
# CONFIG_6LOWPAN_GHC_EXT_HDR_HOP is not set
# CONFIG_6LOWPAN_GHC_UDP is not set
# CONFIG_6LOWPAN_GHC_ICMPV6 is not set
# CONFIG_6LOWPAN_GHC_EXT_HDR_DEST is not set
# CONFIG_6LOWPAN_GHC_EXT_HDR_FRAG is not set
# CONFIG_6LOWPAN_GHC_EXT_HDR_ROUTE is not set

CONFIG_IEEE802154=m
CONFIG_IEEE802154_NL802154_EXPERIMENTAL=y
CONFIG_IEEE802154_SOCKET=m
CONFIG_IEEE802154_6LOWPAN=m
CONFIG_MAC802154=m

CONFIG_IEEE802154_DRIVERS=m
CONFIG_IEEE802154_FAKELB=m
CONFIG_IEEE802154_AT86RF230=m
# CONFIG_IEEE802154_AT86RF230_DEBUGFS is not set
# CONFIG_IEEE802154_MRF24J40 is not set
# CONFIG_IEEE802154_CC2520 is not set
# CONFIG_IEEE802154_ATUSB is not set
# CONFIG_IEEE802154_ADF7242 is not set

CONFIG_SPI_BCM2835=y
CONFIG_SPI_BCM2835AUX=y
```

## configs/knot_gateway_defconfig
```kconfig
BR2_TOOLCHAIN_BUILDROOT_GLIBC=y
BR2_TOOLCHAIN_BUILDROOT_CXX=y
BR2_GCC_VERSION_4_9_X=y
BR2_TARGET_GENERIC_HOSTNAME="knot"
BR2_TARGET_GENERIC_ISSUE="Welcome to KNoT Gateway"
BR2_TARGET_GENERIC_ROOT_PASSWD="root"
BR2_TARGET_GENERIC_GETTY_PORT="tty1"
BR2_ROOTFS_OVERLAY="board/raspberrypi2/rootfs_overlay"
BR2_ROOTFS_POST_IMAGE_SCRIPT="board/raspberrypi/post-image-knot.sh"
BR2_ROOTFS_POST_SCRIPT_ARGS="--add-spi0-cs --add-spi1-2cs,cs0_pin=5,cs1_pin=6 --add-at86rf233-spi1-overlay"
BR2_LINUX_KERNEL_VERSION="custom"
BR2_LINUX_KERNEL_CONFIG_FRAGMENT_FILES="board/raspberrypi/knot_linux_defconfig"
BR2_LINUX_KERNEL_CUSTOM_TARBALL=y
BR2_LINUX_KERNEL_CUSTOM_TARBALL_LOCATION="https://github.com/raspberrypi/linux/archive/raspberrypi-kernel_1.20180919-1.tar.gz"
BR2_ROOTFS_USERS_TABLES="board/raspberrypi/rootfs_overlay/etc/knot/users"
BR2_TARGET_ROOTFS_EXT2_SIZE="2048M"
BR2_PACKAGE_PYTHON=y
BR2_PACKAGE_PYTHON_SETUPTOOLS=y
BR2_PACKAGE_HOST_PYTHON_PBR=y
BR2_PACKAGE_PYTHON_LOCKFILE=y
BR2_PACKAGE_PYTHON_GOBJECT=y
BR2_PACKAGE_PYTHON_DAEMON=y
BR2_PACKAGE_PYTHON_DOCUTILS=y
BR2_PACKAGE_DBUS_PYTHON=y
BR2_PACKAGE_GETTEXT=y
BR2_PACKAGE_SPI_TOOLS=y
BR2_PACKAGE_NODEJS=y
BR2_PACKAGE_NODEJS_NPM=y
BR2_PACKAGE_MONGODB=y
BR2_PACKAGE_CURL=y
BR2_PACKAGE_LIBWEBSOCKETS=y
BR2_PACKAGE_AVAHI=y
BR2_PACKAGE_AVAHI_DAEMON=y
BR2_PACKAGE_AVAHI_ENABLE_IPV6=n
BR2_PACKAGE_AVAHI_LIBDNSSD_COMPATIBILITY=y
BR2_PACKAGE_LIGHTTPD=y
BR2_PACKAGE_LIGHTTPD_OPENSSL=y
BR2_PACKAGE_NTP=y
BR2_PACKAGE_NETCAT=y
BR2_PACKAGE_OPENSSH=y
BR2_PACKAGE_KNOT_PROTOCOL_LIB=y
BR2_PACKAGE_KNOT_HAL_DRIVER=y
BR2_PACKAGE_KNOT_SERVICE_APP=y
BR2_PACKAGE_KNOT_NETWORK_NRF24=y
BR2_PACKAGE_KNOT_NETSETUP=y
BR2_PACKAGE_KNOT_WEB=y
BR2_PACKAGE_KNOT_FOG=y
BR2_PACKAGE_KNOT_FOG_CONNECTOR=y
BR2_PACKAGE_LOGROTATE=y
BR2_PACKAGE_LIBNFC=y
BR2_PACKAGE_VALGRIND=y
BR2_PACKAGE_GDB=y
BR2_PACKAGE_GDB_DEBUGGER=y
BR2_PACKAGE_GDB_TUI=y
BR2_PACKAGE_STRACE=y
BR2_PACKAGE_LTRACE=y
BR2_PACKAGE_GIT=y
BR2_PACKAGE_CONNMAN=y
BR2_PACKAGE_CONNMAN_CLIENT=y
BR2_PACKAGE_BINUTILS=y
BR2_PACKAGE_BINUTILS_TARGET=y
BR2_PACKAGE_NEARD=y
BR2_PACKAGE_LIBTOOL=y
BR2_PACKAGE_ZLIB=y
BR2_PACKAGE_OPENSSL=y
BR2_PACKAGE_OPENSSL_BIN=y
BR2_PACKAGE_OPENSSL_ENGINES=y
BR2_PACKAGE_LIBNL=y
BR2_PACKAGE_LIBNL_TOOLS=y
BR2_PACKAGE_IPTABLES=y
BR2_PACKAGE_IPTABLES_BPF_NFSYNPROXY=y
BR2_PACKAGE_IPUTILS=y
BR2_PACKAGE_WPAN_TOOLS=y
BR2_PACKAGE_LIBELL=y
BR2_PACKAGE_IWPAND=y
BR2_PACKAGE_WPANTUND=y
BR2_PACKAGE_ERLANG=y
BR2_PACKAGE_RABBITMQ_SERVER=y
BR2_PACKAGE_RPI_BT_FIRMWARE=y
BR2_PACKAGE_BLUEZ5_UTILS=y
BR2_PACKAGE_BLUEZ5_UTILS_CLIENT=y
BR2_PACKAGE_BLUEZ5_UTILS_DEPRECATED=y
BR2_PACKAGE_BLUEZ_TOOLS=y
```

## configs/knot_raspberrypi0w_defconfig
```kconfig
BR2_arm=y
BR2_arm1176jzf_s=y
BR2_ARM_EABIHF=y

# Linux headers same as kernel, a 4.14 series
BR2_PACKAGE_HOST_LINUX_HEADERS_CUSTOM_4_14=y

BR2_TOOLCHAIN_BUILDROOT_CXX=y
BR2_TOOLCHAIN_BUILDROOT_GLIBC=y
BR2_GCC_VERSION_4_9_X=y

BR2_LINUX_KERNEL=y
BR2_LINUX_KERNEL_CUSTOM_TARBALL=y
BR2_LINUX_KERNEL_CUSTOM_TARBALL_LOCATION="https://github.com/raspberrypi/linux/archive/raspberrypi-kernel_1.20180919-1.tar.gz"
BR2_LINUX_KERNEL_DEFCONFIG="bcmrpi"
BR2_LINUX_KERNEL_DTS_SUPPORT=y
BR2_LINUX_KERNEL_INTREE_DTS_NAME="bcm2708-rpi-0-w"

BR2_PACKAGE_RPI_FIRMWARE=y
BR2_PACKAGE_RPI_WIFI_FIRMWARE=y
BR2_PACKAGE_RPI_BT_FIRMWARE=y

# Required tools to create the SD image
BR2_PACKAGE_HOST_DOSFSTOOLS=y
BR2_PACKAGE_HOST_GENIMAGE=y
BR2_PACKAGE_HOST_MTOOLS=y

# Filesystem / image
BR2_TARGET_ROOTFS_EXT2=y
BR2_TARGET_ROOTFS_EXT2_4=y
BR2_TARGET_ROOTFS_EXT2_SIZE="2048M"
# BR2_TARGET_ROOTFS_TAR is not set
BR2_ROOTFS_POST_BUILD_SCRIPT="board/knot/raspberrypi0w/post-build.sh"
BR2_ROOTFS_POST_IMAGE_SCRIPT="board/knot/raspberrypi0w/post-image.sh"

BR2_TARGET_GENERIC_HOSTNAME="knot"
BR2_TARGET_GENERIC_ISSUE="Welcome to KNoT Gateway"
BR2_TARGET_GENERIC_ROOT_PASSWD="root"
BR2_TARGET_GENERIC_GETTY_PORT="tty1"
BR2_ROOTFS_OVERLAY="board/knot/raspberrypi/rootfs_overlay"
BR2_LINUX_KERNEL_VERSION="custom"
BR2_LINUX_KERNEL_CONFIG_FRAGMENT_FILES="board/knot/raspberrypi/knot_linux_defconfig"

BR2_ROOTFS_USERS_TABLES="board/knot/raspberrypi/rootfs_overlay/etc/knot/users"
BR2_ROOTFS_DEVICE_TABLE="board/knot/raspberrypi/device_table.txt"

# Busybox additional configuration
BR2_PACKAGE_BUSYBOX_CONFIG_FRAGMENT_FILES="board/knot/raspberrypi/busybox.conf"

# KNoT packages
BR2_PACKAGE_KNOT_PROTOCOL_LIB=y
BR2_PACKAGE_KNOT_HAL_DRIVER=y
BR2_PACKAGE_KNOT_SERVICE_APP=y
BR2_PACKAGE_KNOT_NETWORK_NRF24=n
BR2_PACKAGE_KNOT_NETSETUP=y
BR2_PACKAGE_KNOT_CONTROL=y
BR2_PACKAGE_KNOT_WEB=y
BR2_PACKAGE_KNOT_FOG=y
BR2_PACKAGE_KNOT_FOG_CONNECTOR=y

BR2_PACKAGE_PYTHON=y
BR2_PACKAGE_PYTHON_SSL=y
BR2_PACKAGE_PYTHON_HASHLIB=y
BR2_PACKAGE_PYTHON_PIKA=y
BR2_PACKAGE_PYTHON_PYMONGO=y
BR2_PACKAGE_PYTHON_SETUPTOOLS=y
BR2_PACKAGE_HOST_PYTHON_PBR=y
BR2_PACKAGE_PYTHON_LOCKFILE=y
BR2_PACKAGE_PYTHON_GOBJECT=y
BR2_PACKAGE_PYTHON_DAEMON=y
BR2_PACKAGE_PYTHON_DOCUTILS=y
BR2_PACKAGE_DBUS_PYTHON=y
BR2_PACKAGE_GETTEXT=y
BR2_PACKAGE_SPI_TOOLS=y
BR2_PACKAGE_NODEJS=y
BR2_PACKAGE_NODEJS_NPM=y
BR2_PACKAGE_MONGODB=y
BR2_PACKAGE_CURL=y
BR2_PACKAGE_AVAHI=y
BR2_PACKAGE_AVAHI_DAEMON=y
BR2_PACKAGE_AVAHI_ENABLE_IPV6=n
BR2_PACKAGE_AVAHI_LIBDNSSD_COMPATIBILITY=y
BR2_PACKAGE_LIGHTTPD=y
BR2_PACKAGE_LIGHTTPD_OPENSSL=y
BR2_PACKAGE_NTP=y
BR2_PACKAGE_NETCAT=y
BR2_PACKAGE_OPENSSH=y
BR2_PACKAGE_LOGROTATE=y
BR2_PACKAGE_LIBNFC=y
BR2_PACKAGE_VALGRIND=y
BR2_PACKAGE_GDB=y
BR2_PACKAGE_GDB_DEBUGGER=y
BR2_PACKAGE_GDB_TUI=y
BR2_PACKAGE_STRACE=y
BR2_PACKAGE_LTRACE=y
BR2_PACKAGE_GIT=y
BR2_PACKAGE_CONNMAN=y
BR2_PACKAGE_CONNMAN_CLIENT=y
BR2_PACKAGE_CONNMAN_WIFI=y
BR2_PACKAGE_BINUTILS=y
BR2_PACKAGE_BINUTILS_TARGET=y
BR2_PACKAGE_NEARD=y
BR2_PACKAGE_LIBTOOL=y
BR2_PACKAGE_ZLIB=y
BR2_PACKAGE_OPENSSL=y
BR2_PACKAGE_OPENSSL_BIN=y
BR2_PACKAGE_OPENSSL_ENGINES=y
BR2_PACKAGE_LIBNL=y
BR2_PACKAGE_LIBNL_TOOLS=y
BR2_PACKAGE_IPTABLES=y
BR2_PACKAGE_IPTABLES_BPF_NFSYNPROXY=y
BR2_PACKAGE_IPUTILS=y
BR2_PACKAGE_WPAN_TOOLS=y
BR2_PACKAGE_LIBELL=y
BR2_PACKAGE_IWPAND=y
BR2_PACKAGE_WPANTUND=y
BR2_PACKAGE_ERLANG=y
BR2_PACKAGE_RABBITMQ_SERVER=y
BR2_PACKAGE_BLUEZ5_UTILS=y
BR2_PACKAGE_BLUEZ5_UTILS_CLIENT=y
BR2_PACKAGE_BLUEZ5_UTILS_DEPRECATED=y
BR2_PACKAGE_BLUEZ_TOOLS=y
BR2_PACKAGE_WPA_SUPPLICANT_AP_SUPPORT=y
```

## configs/knot_v03_rpi3_defconfig
```kconfig
BR2_arm=y
BR2_cortex_a53=y
BR2_ARM_FPU_NEON_VFPV4=y

BR2_TOOLCHAIN_BUILDROOT_CXX=y
BR2_TOOLCHAIN_BUILDROOT_GLIBC=y
BR2_GCC_VERSION_4_9_X=y

BR2_SYSTEM_DHCP="eth0"

# Linux headers same as kernel, a 4.14 series
BR2_PACKAGE_HOST_LINUX_HEADERS_CUSTOM_4_14=y

BR2_LINUX_KERNEL=y
BR2_LINUX_KERNEL_CUSTOM_TARBALL=y
BR2_LINUX_KERNEL_CUSTOM_TARBALL_LOCATION="https://github.com/raspberrypi/linux/archive/raspberrypi-kernel_1.20180919-1.tar.gz"
BR2_LINUX_KERNEL_DEFCONFIG="bcm2709"

# Build the DTB from the kernel sources
BR2_LINUX_KERNEL_DTS_SUPPORT=y
BR2_LINUX_KERNEL_INTREE_DTS_NAME="bcm2710-rpi-3-b bcm2710-rpi-3-b-plus bcm2710-rpi-cm3"

BR2_PACKAGE_RPI_FIRMWARE=y
BR2_PACKAGE_RPI_WIFI_FIRMWARE=y

# Required tools to create the SD image
BR2_PACKAGE_HOST_DOSFSTOOLS=y
BR2_PACKAGE_HOST_GENIMAGE=y
BR2_PACKAGE_HOST_MTOOLS=y

# Filesystem / image
BR2_TARGET_ROOTFS_EXT2=y
BR2_TARGET_ROOTFS_EXT2_4=y
BR2_TARGET_ROOTFS_EXT2_SIZE="2048M"
# BR2_TARGET_ROOTFS_TAR is not set
BR2_ROOTFS_POST_BUILD_SCRIPT="board/knot/raspberrypi3/post-build.sh"
BR2_ROOTFS_POST_IMAGE_SCRIPT="board/knot/raspberrypi3/post-image.sh"


BR2_TARGET_GENERIC_HOSTNAME="knot"
BR2_TARGET_GENERIC_ISSUE="Welcome to KNoT Gateway"
BR2_TARGET_GENERIC_ROOT_PASSWD="root"
BR2_TARGET_GENERIC_GETTY_PORT="tty1"
BR2_ROOTFS_OVERLAY="board/knot/raspberrypi/rootfs_overlay"
BR2_ROOTFS_POST_SCRIPT_ARGS="--add-spi0-cs --add-spi1-2cs,cs0_pin=5,cs1_pin=6 --add-at86rf233-spi1-overlay"
BR2_LINUX_KERNEL_VERSION="custom"
BR2_LINUX_KERNEL_CONFIG_FRAGMENT_FILES="board/knot/raspberrypi/knot_linux_defconfig"

BR2_ROOTFS_USERS_TABLES="board/knot/raspberrypi/rootfs_overlay/etc/knot/users"
BR2_ROOTFS_DEVICE_TABLE="board/knot/raspberrypi/device_table.txt"

# Busybox additional configuration
BR2_PACKAGE_BUSYBOX_CONFIG_FRAGMENT_FILES="board/knot/raspberrypi/busybox.conf"

# KNoT packages
BR2_PACKAGE_KNOT_VIRTUALTHING=y
BR2_PACKAGE_KNOT_NETSETUP=y
BR2_PACKAGE_KNOT_WEB=y
BR2_PACKAGE_KNOT_FOG_CONNECTOR=y
BR2_PACKAGE_KNOT_BABELTOWER=y
BR2_PACKAGE_KNOT_STORAGE=y

BR2_PACKAGE_PYTHON=y
BR2_PACKAGE_PYTHON_SSL=y
BR2_PACKAGE_PYTHON_HASHLIB=y
BR2_PACKAGE_HOST_PYTHON_PBR=y
BR2_PACKAGE_GETTEXT=y
BR2_PACKAGE_SPI_TOOLS=y
BR2_PACKAGE_NODEJS=y
BR2_PACKAGE_NODEJS_NPM=y
BR2_PACKAGE_MONGODB=y
BR2_PACKAGE_CURL=y
BR2_PACKAGE_AVAHI=y
BR2_PACKAGE_AVAHI_DAEMON=y
BR2_PACKAGE_AVAHI_ENABLE_IPV6=n
BR2_PACKAGE_AVAHI_LIBDNSSD_COMPATIBILITY=y
BR2_PACKAGE_LIGHTTPD=y
BR2_PACKAGE_LIGHTTPD_OPENSSL=y
BR2_PACKAGE_NTP=y
BR2_PACKAGE_NETCAT=y
BR2_PACKAGE_OPENSSH=y
BR2_PACKAGE_LOGROTATE=y
BR2_PACKAGE_LIBNFC=y
BR2_PACKAGE_VALGRIND=y
BR2_PACKAGE_GDB=y
BR2_PACKAGE_GDB_DEBUGGER=y
BR2_PACKAGE_GDB_TUI=y
BR2_PACKAGE_STRACE=y
BR2_PACKAGE_LTRACE=y
BR2_PACKAGE_GIT=y
BR2_PACKAGE_CONNMAN=y
BR2_PACKAGE_CONNMAN_CLIENT=y
BR2_PACKAGE_CONNMAN_WIFI=y
BR2_PACKAGE_BINUTILS=y
BR2_PACKAGE_BINUTILS_TARGET=y
BR2_PACKAGE_NEARD=y
BR2_PACKAGE_LIBTOOL=y
BR2_PACKAGE_ZLIB=y
BR2_PACKAGE_OPENSSL=y
BR2_PACKAGE_OPENSSL_BIN=y
BR2_PACKAGE_OPENSSL_ENGINES=y
BR2_PACKAGE_LIBNL=y
BR2_PACKAGE_LIBNL_TOOLS=y
BR2_PACKAGE_IPTABLES=y
BR2_PACKAGE_IPTABLES_BPF_NFSYNPROXY=y
BR2_PACKAGE_IPUTILS=y
BR2_PACKAGE_WPAN_TOOLS=y
BR2_PACKAGE_IWPAND=y
BR2_PACKAGE_WPANTUND=y
BR2_PACKAGE_ERLANG=y
BR2_PACKAGE_RABBITMQ_SERVER=y
BR2_PACKAGE_RPI_BT_FIRMWARE=y
BR2_PACKAGE_BLUEZ5_UTILS=y
BR2_PACKAGE_BLUEZ5_UTILS_CLIENT=y
BR2_PACKAGE_BLUEZ5_UTILS_DEPRECATED=y
BR2_PACKAGE_BLUEZ_TOOLS=y
BR2_PACKAGE_WPA_SUPPLICANT_AP_SUPPORT=y
BR2_PACKAGE_POSTGRESQL=y
BR2_PACKAGE_MAINFLUX=y
```

## package/bitcoin/Config.in
```kconfig
config BR2_PACKAGE_BITCOIN
	bool "bitcoin"
	select BR2_TOOLCHAIN_BUILDROOT_USE_SSP
	select BR2_INSTALL_LIBSTDCPP
	select BR2_PACKAGE_BOOST
	select BR2_PACKAGE_BOOST_SYSTEM
	select BR2_PACKAGE_BOOST_FILESYSTEM
	select BR2_PACKAGE_BOOST_THREAD
	select BR2_PACKAGE_BOOST_CHRONO
	select BR2_PACKAGE_BOOST_PROGRAM_OPTIONS
	select BR2_PACKAGE_OPENSSL
	select BR2_PACKAGE_LIBEVENT
	help
	  Bitcoin Core is an open source project which maintains and
	  releases Bitcoin client software called “Bitcoin Core”.

	  It is a direct descendant of the original Bitcoin software
	  client released by Satoshi Nakamoto after he published the
	  famous Bitcoin whitepaper.

	  Bitcoin Core consists of both “full-node” software for fully
	  validating the blockchain as well as a bitcoin wallet. The
	  project also currently maintains related software such as the
	  cryptography library libsecp256k1 and others located at GitHub.

	  https://bitcoincore.org
```

## package/btcd/Config.in
```kconfig
config BR2_PACKAGE_BTCD
	bool "btcd"
	depends on BR2_PACKAGE_HOST_GO_ARCH_SUPPORTS
	select BR2_PACKAGE_HOST_GO_GLIDE
	help
	  btcd is an alternative full node bitcoin implementation
	  written in Go (golang).

	  https://github.com/btcsuite/btcd
```

## package/go-dep/Config.in.host
```kconfig
config BR2_PACKAGE_HOST_GO_DEP
	bool "host dep"
	depends on BR2_PACKAGE_HOST_GO_ARCH_SUPPORTS
	help
	  Go dependency management tool.

	  https://golang.github.io/dep/
```

## package/go-glide/Config.in.host
```kconfig
config BR2_PACKAGE_HOST_GO_GLIDE
	bool "host glide"
	depends on BR2_PACKAGE_HOST_GO_ARCH_SUPPORTS
	help
	  Glide is a tool for managing the _vendor_ directory within a Go
	  package. This feature, first introduced in Go 1.5, allows each
	  package to have a _vendor_ directory containing dependent
	  packages for the project. These vendor packages can be
	  installed by a tool (e.g. glide), similar to go get or they
	  can be vendored and distributed with the package.

	  https://github.com/Masterminds/glide
```

## package/iwpand/Config.in
```kconfig
config BR2_PACKAGE_IWPAND
	bool "iwpand"
	 select BR2_PACKAGE_LIBNL
	 select BR2_PACKAGE_LIBELL
	help
	  iwpand provides an user space daemon to manage 802.15.4 connections.
```

## package/knot-babeltower/Config.in
```kconfig
config BR2_PACKAGE_KNOT_BABELTOWER
    bool "knot-babeltower"
    depends on BR2_PACKAGE_HOST_GO_ARCH_SUPPORTS
    depends on BR2_PACKAGE_HOST_GO_CGO_LINKING_SUPPORTS
    depends on BR2_PACKAGE_RABBITMQ_SERVER
    depends on BR2_PACKAGE_MAINFLUX
    help
        Service that orchestrates communication with the fog services
        acting both as a proxy and a protocol translator since the internal
        operations can be made to services that support different application
        protocols.
        https://github.com/cesarbr/knot-babeltower
```

## package/knot-cloud-sdk/Config.in
```kconfig
config BR2_PACKAGE_KNOT_CLOUD_SDK
	bool "knot-cloud-sdk"
	select BR2_PACKAGE_LIBELL
	select BR2_PACKAGE_JSON_C
	select BR2_PACKAGE_RABBITMQ_C
	select BR2_PACKAGE_KNOT_PROTOCOL_LIB
	help
	  KNoT Cloud SDK in C is part of the KNoT project.
	  It is a client-side library that provides an AMQP
	  abstraction to the KNoT Cloud for C applications.
```

## package/knot-control/Config.in
```kconfig
config BR2_PACKAGE_KNOT_CONTROL
	bool "knot-control"
	select BR2_PACKAGE_PYTHON_PIKA
	select BR2_PACKAGE_PYTHON_PYMONGO
	select BR2_PACKAGE_PYTHON_SETUPTOOLS
	select BR2_PACKAGE_PYTHON_LOCKFILE
	select BR2_PACKAGE_PYTHON_GOBJECT
	select BR2_PACKAGE_PYTHON_DAEMON
	select BR2_PACKAGE_DBUS_PYTHON

	help
	  KNoT Gateway process used to control the hardware status and configurations.
```

## package/knot-fog-connector/Config.in
```kconfig
config BR2_PACKAGE_KNOT_FOG_CONNECTOR
	bool "knot-fog-connector"
	depends on BR2_PACKAGE_KNOT_FOG
	depends on BR2_PACKAGE_RABBITMQ_SERVER
	select BR2_PACKAGE_NODEJS
	help
	  The Fog Connector synchronizes device data between the KNoT Fog
	  and other IoT cloud platforms,e.g. AWS IoT, FIWARE or Konker.
```

## package/knot-fog/Config.in
```kconfig
config BR2_PACKAGE_KNOT_FOG
    bool "knot-fog"
    depends on BR2_PACKAGE_MONGODB
    select BR2_PACKAGE_NODEJS
    help
      The KNoT Fog is responsible for providing IoT cloud capabilities
	  in the gateway, such as message brokering, data storage, and data
	  processing, as well as for providing local access to devices when
	  Internet connection is not available.
```

## package/knot-hal-driver/Config.in
```kconfig
config BR2_PACKAGE_KNOT_HAL_DRIVER
	bool "knot-hal-driver"
	select BR2_PACKAGE_JSON_C
	select BR2_PACKAGE_LIBGLIB2
	help
	  KNOT HAL is part of KNOT project. It aims to provide hardware
	  abstraction layer for SPI and nRF24L01 radios. Allowing power
	  constrained embedded devices to join a wireless network and
	  exchange datagrams using nRF24L01 radios.
```
