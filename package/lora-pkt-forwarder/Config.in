## package/lora-pkt-forwarder/Config.in
```kconfig
config BR2_PACKAGE_LORA_PKT_FORWARDER
    bool "lora-pkt-forwarder"
	depends on BR2_PACKAGE_LORA_GATEWAY
	help
		TODO
```

## package/mainflux/Config.in
```kconfig
config BR2_PACKAGE_MAINFLUX
    bool "mainflux"
    depends on BR2_PACKAGE_HOST_GO_ARCH_SUPPORTS
    depends on BR2_PACKAGE_HOST_GO_CGO_LINKING_SUPPORTS
    depends on BR2_PACKAGE_POSTGRESQL
    help
      Mainflux is modern, scalable, secure, open-source, and patent-free IoT cloud
      platform written in Go. It accepts user and thing connections over various
      network protocols (i.e. HTTP, MQTT, WebSocket, CoAP), thus making a seamless
      bridge between them. It is used as the IoT middleware for building complex IoT
      solutions.

      https://github.com/mainflux/mainflux
```

## package/meshblu/Config.in
```kconfig
config BR2_PACKAGE_MESHBLU
        bool "libfoo"
        #depends on BR2_PACKAGE_MONGODB
        depends on BR2_PACKAGE_NODEJS
        help
          Machine-to-machine instant messaging platform for the internet of things #IoT.
          
          http://developer.octoblu.com
```

## package/neutrino/Config.in
```kconfig
config BR2_PACKAGE_NEUTRINO
	bool "neutrino"
	depends on BR2_PACKAGE_HOST_GO_ARCH_SUPPORTS
	select BR2_PACKAGE_HOST_GO_GLIDE
	help
	  Neutrino is an experimental Bitcoin light client written in Go
	  and designed with mobile Lightning Network clients in mind. It
	  uses a new proposal for compact block filters to minimize
	  bandwidth and storage use on the client side, while attempting
	  to preserve privacy and minimize processor load on full nodes
	  serving light clients.

	  https://github.com/lightninglabs/neutrino
```

## package/python-lockfile/Config.in
```kconfig
config BR2_PACKAGE_PYTHON_LOCKFILE
	bool "python-lockfile"
	select BR2_PACKAGE_HOST_PYTHON_PBR
	help
	  Platform-independent file locking module.

	  https://pypi.org/project/lockfile
```

## package/python-pbr/Config.in.host
```kconfig
config BR2_PACKAGE_HOST_PYTHON_PBR
	bool "host python-pbr"
	help
	  Python Build Reasonableness.

	  https://pypi.org/project/pbr
```

## package/python-pika/Config.in
```kconfig
config BR2_PACKAGE_PYTHON_PIKA
	bool "python-pika"
	depends on BR2_PACKAGE_PYTHON
	select BR2_PACKAGE_PYTHON_SSL
	help
	  An implementation of the AMQP 0-9-1 protocol for Python.

	  https://pypi.org/project/pika/
```

## package/python-pymongo/Config.in
```kconfig
config BR2_PACKAGE_PYTHON_PYMONGO
	bool "python-pymongo"
	depends on BR2_PACKAGE_PYTHON
	help
	  An implementation of MongoDB for Python.

	  https://pypi.org/project/pymongo/
```

## package/wpantund/Config.in
```kconfig
config BR2_PACKAGE_WPANTUND
	bool "wpantund"
	select BR2_PACKAGE_BOOST
	help
	  Wireless Network Interface Daemon for Low-Power Wireless SoCs
```
